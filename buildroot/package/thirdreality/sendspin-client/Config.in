## buildroot/package/thirdreality/sendspin-client/Config.in
```kconfig
config BR2_PACKAGE_SENDSPIN_CLIENT
	bool "sendspin-client"
	depends on BR2_INSTALL_LIBSTDCPP
	depends on BR2_TOOLCHAIN_HAS_THREADS
	select BR2_PACKAGE_PULSEAUDIO
	select BR2_PACKAGE_TR_VOLUME
	select BR2_PACKAGE_AVAHI
	select BR2_PACKAGE_AVAHI_DAEMON
	select BR2_PACKAGE_AVAHI_LIBDNSSD_COMPATIBILITY
	help
	  Sendspin synchronized audio streaming client for ThirdReality speaker.
	  Uses PulseAudio for audio output and Avahi for mDNS discovery.

	  https://github.com/Sendspin/sendspin-cpp
```

## buildroot/package/thirdreality/tr-proj-ha-speaker/Config.in
```kconfig
config BR2_PACKAGE_TR_PROJ_HA_SPEAKER
    bool "thirdreality ha speaker project"
    depends on BR2_PACKAGE_PULSEAUDIO
    default n
    select BR2_PACKAGE_TR_VOLUME
    help
        enable thirdreality ha speaker project
```

## buildroot/package/thirdreality/tr-volume/Config.in
```kconfig
config BR2_PACKAGE_TR_VOLUME
	bool "tr-volume"
	depends on BR2_PACKAGE_PULSEAUDIO
	help
	  Apply the ThirdReality logical volume curve to the default
	  PulseAudio sink.
```
